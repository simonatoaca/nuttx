## drivers/motor/Kconfig
```kconfig
#
# For a description of the syntax of this configuration file,
# see the file kconfig-language.txt in the NuttX tools repository.
#

menuconfig MOTOR
	bool "Motor control drivers"
	default n

if MOTOR

config MOTOR_UPPER
	bool "Motor generic upper-half driver"
	default n
	---help---
		Enables building of a motor generic upper half driver.

if MOTOR_UPPER

config MOTOR_UPPER_HAVE_POSITION
	bool "Have position control"
	default n

config MOTOR_UPPER_HAVE_DIRECTION
	bool "Have direction control"
	default n

config MOTOR_UPPER_HAVE_SPEED
	bool "Have speed control"
	default n

config MOTOR_UPPER_HAVE_TORQUE
	bool "Have torque control (rotary motors)"
	default n

config MOTOR_UPPER_HAVE_FORCE
	bool "Have force control (linear motors)"
	default n

config MOTOR_UPPER_HAVE_ACCELERATION
	bool "Have acceleration control"
	default n

config MOTOR_UPPER_HAVE_DECELERATION
	bool "Have deceleration control"
	default n

config MOTOR_UPPER_HAVE_INPUT_VOLTAGE
	bool "Have input voltage protection"
	default n

config MOTOR_UPPER_HAVE_INPUT_CURRENT
	bool "Have input current protection"
	default n

config MOTOR_UPPER_HAVE_INPUT_POWER
	bool "Have input power protection"
	default n

endif

source "drivers/motor/foc/Kconfig"

endif # MOTOR

menuconfig STEPPER
	bool "Stepper control drivers"
	default n

if STEPPER

config STEPPER_UPPER
	bool "Stepper Motor Generic upper-half driver"
	default n
	---help---
		Enables building of a stepper generic upper half driver.

config STEPPER_A4988
	bool "A4988 Stepper Motor Driver"
	default n
	---help---
		Enables A4988 stepper driver.

config STEPPER_DRV8825
	bool "DRV8825 Stepper Motor Driver"
	default n
	---help---
		Enables DRV8825 stepper driver.

endif # STEPPER

menuconfig HAPTIC
	bool "Haptic control drivers"
	default n

if HAPTIC

config HAPTIC_DRV2605L
	bool "DRV2605L Haptic Driver"
	default n
	select I2C
	---help---
		Enables DRV2605L haptic driver

if HAPTIC_DRV2605L

config DRV2605L_I2C_FREQUENCY
	int "DRV2605L I2C frequency"
	default 400000

config DRV2605L_EN_PIN
	int "DRV2605L Enable Pin"
	default 17

config DRV2605L_IN_TRIG_PIN
	int "DRV2605L Input/Trigger Pin"
	default 16

choice
	prompt "DRV2605L Actuator"
	default LRA_ACTUATOR

config LRA_ACTUATOR
	bool "LRA Actuator"
	---help---
		The actuator connected to the out +/- pins of the driver is LRA.

config ERM_ACTUATOR
	bool "ERM Actuator"
	---help---
		The actuator connected to the out +/- pins of the driver is ERM.

endchoice # DRV2605L Actuator

choice
	prompt "DRV2605L Mode"
	default CLOSED_LOOP_UNIDIR_MODE

config CLOSED_LOOP_UNIDIR_MODE
	bool "Closed Loop Unidirectional Mode"
	---help---

config CLOSED_LOOP_BIDIR_MODE
	bool "Closed Loop Bidirectional Mode"
	---help---

config OPEN_LOOP_MODE
	bool "Open Loop Mode"
	---help---

endchoice # DRV2605L Mode

endif # HAPTIC_DRV2605L

endif # HAPTIC
```
